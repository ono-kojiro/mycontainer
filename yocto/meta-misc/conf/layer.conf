## yocto/meta-misc/conf/layer.conf
```bitbake
# We have a conf and classes directory, add to BBPATH
BBPATH .= ":${LAYERDIR}"

# We have recipes-* directories, add to BBFILES
BBFILES += "${LAYERDIR}/recipes-*/*/*.bb \
            ${LAYERDIR}/recipes-*/*/*.bbappend"

BBFILE_COLLECTIONS += "meta-misc"
BBFILE_PATTERN_meta-misc = "^${LAYERDIR}/"
#BBFILE_PRIORITY_meta-misc = "6"
BBFILE_PRIORITY_meta-misc = "5"
```
